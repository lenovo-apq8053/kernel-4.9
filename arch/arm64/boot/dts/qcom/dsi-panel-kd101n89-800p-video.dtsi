/* Novatek Android Driver Sample Code for Novatek chipset
*
* Copyright (C) 2018 Novatek Microelectronics Corp.
*
* This software is licensed under the terms of the GNU General Public
* License version 2, as published by the Free Software Foundation, and
* may be copied, distributed, and modified under those terms.
*
* This program is distributed in the hope that it will be useful,
* but WITHOUT ANY WARRANTY; without even the implied warranty of
* MERCHANTABILITY or FITNESS FOR A PARTICULAR PURPOSE.  See the
* GNU General Public License for more details.
*
*/

&mdss_mdp {
        dsi_kd101n89_800p_video: qcom,mdss_dsi_kd101n89_800p_video {
		qcom,mdss-dsi-panel-name = "JD9365 KD101N89 800P MDSS";
		qcom,mdss-dsi-panel-controller = <&mdss_dsi0>;
		qcom,mdss-dsi-panel-type = "dsi_video_mode";
		qcom,mdss-dsi-panel-framerate = <60>;
		qcom,mdss-dsi-virtual-channel-id = <0>;
		qcom,mdss-dsi-stream = <0>;
		qcom,mdss-dsi-panel-width = <800>;
		qcom,mdss-dsi-panel-height = <1280>;
		qcom,mdss-dsi-h-front-porch = <18>;
		qcom,mdss-dsi-h-back-porch = <18>;
		qcom,mdss-dsi-h-pulse-width = <18>;
		qcom,mdss-dsi-h-sync-skew = <0>;
		qcom,mdss-dsi-v-back-porch = <4>;
		qcom,mdss-dsi-v-front-porch = <16>;
		qcom,mdss-dsi-v-pulse-width = <4>;
		qcom,mdss-dsi-h-left-border = <0>;
		qcom,mdss-dsi-h-right-border = <0>;
		qcom,mdss-dsi-v-top-border = <0>;
		qcom,mdss-dsi-v-bottom-border = <0>;
		qcom,mdss-dsi-bpp = <24>;
		qcom,mdss-dsi-underflow-color = <0xff>;
		qcom,mdss-dsi-border-color = <0>;
		qcom,mdss-dsi-on-command = [
			15 01 00 00 00 00 02 E0 00
			15 01 00 00 00 00 02 E1 93
			15 01 00 00 00 00 02 E2 65
			15 01 00 00 00 00 02 E3 F8
			15 01 00 00 00 00 02 80 03
			15 01 00 00 00 00 02 E0 01
			15 01 00 00 00 00 02 01 67
			15 01 00 00 00 00 02 17 00
			15 01 00 00 00 00 02 18 BF
			15 01 00 00 00 00 02 19 01
			15 01 00 00 00 00 02 1A 00
			15 01 00 00 00 00 02 1B BF
			15 01 00 00 00 00 02 1C 01
			15 01 00 00 00 00 02 1F 70
			15 01 00 00 00 00 02 20 2D
			15 01 00 00 00 00 02 21 2D
			15 01 00 00 00 00 02 22 7E
			15 01 00 00 00 00 02 35 28
			15 01 00 00 00 00 02 37 19
			15 01 00 00 00 00 02 38 05
			15 01 00 00 00 00 02 39 00
			15 01 00 00 00 00 02 3A 01
			15 01 00 00 00 00 02 3C 7C
			15 01 00 00 00 00 02 3D FF
			15 01 00 00 00 00 02 3E FF
			15 01 00 00 00 00 02 3F 7F
			15 01 00 00 00 00 02 40 06
			15 01 00 00 00 00 02 41 A0
			15 01 00 00 00 00 02 43 1E
			15 01 00 00 00 00 02 44 0B
			15 01 00 00 00 00 02 45 28
			15 01 00 00 00 00 02 55 01
			15 01 00 00 00 00 02 56 01
			15 01 00 00 00 00 02 57 69
			15 01 00 00 00 00 02 58 0A
			15 01 00 00 00 00 02 59 2A
			15 01 00 00 00 00 02 5A 29
			15 01 00 00 00 00 02 5B 15
			15 01 00 00 00 00 02 5C 16
			15 01 00 00 00 00 02 5D 7F
			15 01 00 00 00 00 02 5E 64
			15 01 00 00 00 00 02 5F 53
			15 01 00 00 00 00 02 60 47
			15 01 00 00 00 00 02 61 43
			15 01 00 00 00 00 02 62 33
			15 01 00 00 00 00 02 63 37
			15 01 00 00 00 00 02 64 21
			15 01 00 00 00 00 02 65 39
			15 01 00 00 00 00 02 66 37
			15 01 00 00 00 00 02 67 34
			15 01 00 00 00 00 02 68 50
			15 01 00 00 00 00 02 69 3D
			15 01 00 00 00 00 02 6A 44
			15 01 00 00 00 00 02 6B 36
			15 01 00 00 00 00 02 6C 34
			15 01 00 00 00 00 02 6D 25
			15 01 00 00 00 00 02 6E 15
			15 01 00 00 00 00 02 6F 02
			15 01 00 00 00 00 02 70 7F
			15 01 00 00 00 00 02 71 64
			15 01 00 00 00 00 02 72 53
			15 01 00 00 00 00 02 73 47
			15 01 00 00 00 00 02 74 43
			15 01 00 00 00 00 02 75 33
			15 01 00 00 00 00 02 76 37
			15 01 00 00 00 00 02 77 21
			15 01 00 00 00 00 02 78 39
			15 01 00 00 00 00 02 79 37
			15 01 00 00 00 00 02 7A 34
			15 01 00 00 00 00 02 7B 50
			15 01 00 00 00 00 02 7C 3D
			15 01 00 00 00 00 02 7D 44
			15 01 00 00 00 00 02 7E 36
			15 01 00 00 00 00 02 7F 34
			15 01 00 00 00 00 02 80 25
			15 01 00 00 00 00 02 81 15
			15 01 00 00 00 00 02 82 02
			15 01 00 00 00 00 02 E0 02
			15 01 00 00 00 00 02 00 52
			15 01 00 00 00 00 02 01 55
			15 01 00 00 00 00 02 02 55
			15 01 00 00 00 00 02 03 50
			15 01 00 00 00 00 02 04 77
			15 01 00 00 00 00 02 05 57
			15 01 00 00 00 00 02 06 55
			15 01 00 00 00 00 02 07 4E
			15 01 00 00 00 00 02 08 4C
			15 01 00 00 00 00 02 09 5F
			15 01 00 00 00 00 02 0A 4A
			15 01 00 00 00 00 02 0B 48
			15 01 00 00 00 00 02 0C 55
			15 01 00 00 00 00 02 0D 46
			15 01 00 00 00 00 02 0E 44
			15 01 00 00 00 00 02 0F 40
			15 01 00 00 00 00 02 10 55
			15 01 00 00 00 00 02 11 55
			15 01 00 00 00 00 02 12 55
			15 01 00 00 00 00 02 13 55
			15 01 00 00 00 00 02 14 55
			15 01 00 00 00 00 02 15 55
			15 01 00 00 00 00 02 16 53
			15 01 00 00 00 00 02 17 55
			15 01 00 00 00 00 02 18 55
			15 01 00 00 00 00 02 19 51
			15 01 00 00 00 00 02 1A 77
			15 01 00 00 00 00 02 1B 57
			15 01 00 00 00 00 02 1C 55
			15 01 00 00 00 00 02 1D 4F
			15 01 00 00 00 00 02 1E 4D
			15 01 00 00 00 00 02 1F 5F
			15 01 00 00 00 00 02 20 4B
			15 01 00 00 00 00 02 21 49
			15 01 00 00 00 00 02 22 55
			15 01 00 00 00 00 02 23 47
			15 01 00 00 00 00 02 24 45
			15 01 00 00 00 00 02 25 41
			15 01 00 00 00 00 02 26 55
			15 01 00 00 00 00 02 27 55
			15 01 00 00 00 00 02 28 55
			15 01 00 00 00 00 02 29 55
			15 01 00 00 00 00 02 2A 55
			15 01 00 00 00 00 02 2B 55
			15 01 00 00 00 00 02 2C 13
			15 01 00 00 00 00 02 2D 15
			15 01 00 00 00 00 02 2E 15
			15 01 00 00 00 00 02 2F 01
			15 01 00 00 00 00 02 30 37
			15 01 00 00 00 00 02 31 17
			15 01 00 00 00 00 02 32 15
			15 01 00 00 00 00 02 33 0D
			15 01 00 00 00 00 02 34 0F
			15 01 00 00 00 00 02 35 15
			15 01 00 00 00 00 02 36 05
			15 01 00 00 00 00 02 37 07
			15 01 00 00 00 00 02 38 15
			15 01 00 00 00 00 02 39 09
			15 01 00 00 00 00 02 3A 0B
			15 01 00 00 00 00 02 3B 11
			15 01 00 00 00 00 02 3C 15
			15 01 00 00 00 00 02 3D 15
			15 01 00 00 00 00 02 3E 15
			15 01 00 00 00 00 02 3F 15
			15 01 00 00 00 00 02 40 15
			15 01 00 00 00 00 02 41 15
			15 01 00 00 00 00 02 42 12
			15 01 00 00 00 00 02 43 15
			15 01 00 00 00 00 02 44 15
			15 01 00 00 00 00 02 45 00
			15 01 00 00 00 00 02 46 37
			15 01 00 00 00 00 02 47 17
			15 01 00 00 00 00 02 48 15
			15 01 00 00 00 00 02 49 0C
			15 01 00 00 00 00 02 4A 0E
			15 01 00 00 00 00 02 4B 15
			15 01 00 00 00 00 02 4C 04
			15 01 00 00 00 00 02 4D 06
			15 01 00 00 00 00 02 4E 15
			15 01 00 00 00 00 02 4F 08
			15 01 00 00 00 00 02 50 0A
			15 01 00 00 00 00 02 51 10
			15 01 00 00 00 00 02 52 15
			15 01 00 00 00 00 02 53 15
			15 01 00 00 00 00 02 54 15
			15 01 00 00 00 00 02 55 15
			15 01 00 00 00 00 02 56 15
			15 01 00 00 00 00 02 57 15
			15 01 00 00 00 00 02 58 40
			15 01 00 00 00 00 02 5B 10
			15 01 00 00 00 00 02 5C 06
			15 01 00 00 00 00 02 5D 40
			15 01 00 00 00 00 02 5E 00
			15 01 00 00 00 00 02 5F 00
			15 01 00 00 00 00 02 60 40
			15 01 00 00 00 00 02 61 03
			15 01 00 00 00 00 02 62 04
			15 01 00 00 00 00 02 63 6C
			15 01 00 00 00 00 02 64 6C
			15 01 00 00 00 00 02 65 75
			15 01 00 00 00 00 02 66 08
			15 01 00 00 00 00 02 67 B4
			15 01 00 00 00 00 02 68 08
			15 01 00 00 00 00 02 69 6C
			15 01 00 00 00 00 02 6A 6C
			15 01 00 00 00 00 02 6B 0C
			15 01 00 00 00 00 02 6D 00
			15 01 00 00 00 00 02 6E 00
			15 01 00 00 00 00 02 6F 88
			15 01 00 00 00 00 02 75 BB
			15 01 00 00 00 00 02 76 00
			15 01 00 00 00 00 02 77 05
			15 01 00 00 00 00 02 78 2A
			15 01 00 00 00 00 02 E0 04
			15 01 00 00 00 00 02 09 11
			15 01 00 00 00 00 02 0E 48
			15 01 00 00 00 00 02 2B 2B
			15 01 00 00 00 00 02 2D 03
			15 01 00 00 00 00 02 2E 44
			15 01 00 00 00 00 02 E0 05
			15 01 00 00 00 00 02 12 72
			15 01 00 00 00 00 02 E0 00
			15 01 00 00 00 00 02 E6 02
			15 01 00 00 00 00 02 E7 0C
			05 01 00 00 78 00 01 11
			05 01 00 00 05 00 01 29
		];
		qcom,mdss-dsi-off-command = [
			39 01 00 00 14 00 02 28 00
			39 01 00 00 78 00 02 10 00	
		];
		qcom,mdss-dsi-on-command-state = "dsi_lp_mode";
		qcom,mdss-dsi-off-command-state = "dsi_lp_mode";
		//qcom,cont-splash-enabled;
		qcom,mdss-dsi-h-sync-pulse = <1>;
		qcom,mdss-dsi-traffic-mode = "burst_mode";
		qcom,mdss-dsi-lane-map = "lane_map_0123";
		qcom,mdss-dsi-bllp-eof-power-mode;
		qcom,mdss-dsi-bllp-power-mode;
		qcom,mdss-dsi-lane-0-state;
		qcom,mdss-dsi-lane-1-state;
		qcom,mdss-dsi-lane-2-state;
		qcom,mdss-dsi-lane-3-state;
		qcom,mdss-dsi-panel-timings = [9B 22 18 00 4A 4E 1C 26 1D 03 04 00];
		qcom,mdss-dsi-t-clk-post = <0x04>;
		qcom,mdss-dsi-t-clk-pre = <0x1C>;
		qcom,mdss-dsi-bl-min-level = <1>;
		qcom,mdss-dsi-bl-max-level = <4095>;
		qcom,panel-supply-entries = <&dsi_panel_pwr_supply>;
		qcom,mdss-dsi-dma-trigger = "trigger_sw";
		qcom,mdss-dsi-mdp-trigger = "none";
		qcom,mdss-dsi-force-clock-lane-hs;
		//qcom,platform-bklight-en-gpio = <&tlmm 46 0>;
		//qcom,mdss-dsi-lcden-ctrl = <&tlmm 61 0>;
		qcom,mdss-dsi-bl-pmic-control-type = "bl_ctrl_wled";
		//qcom,mdss-dsi-bl-pmic-pwm-frequency = <100>;
		//qcom,mdss-dsi-bl-pmic-bank-select = <0>;
		//qcom,mdss-dsi-pwm-gpio = <&pm8953_mpps 4 0>;
		qcom,mdss-pan-physical-width-dimension = <135>;
		qcom,mdss-pan-physical-height-dimension = <216>;
		//qcom,mdss-dsi-reset-sequence = <1 10>, <0 5>, <1 50>;
		qcom,mdss-dsi-lp11-init;
		//qcom,mdss-dsi-post-init-delay = <1>;
		qcom,mdss-dsi-init-delay-us = <50000>;
	};
};
