## drivers/input/touchscreen/hxchipset/Kconfig
```kconfig
#
# Himax Touchscreen driver configuration
#

config TOUCHSCREEN_HIMAX_I2C
	tristate "HIMAX chipset i2c touchscreen"
	depends on TOUCHSCREEN_HIMAX_CHIPSET
	help
	  Say Y to enables support for HIMAX CHIPSET
	  over I2C based touchscreens.

	  If unsure, say N.

config TOUCHSCREEN_HIMAX_DEBUG
	tristate "HIMAX debug function"
	depends on TOUCHSCREEN_HIMAX_I2C
	help
	  Say Y to enables support for HIMAX debug function.

	  If unsure, say N.

config HMX_DB
	tristate "HIMAX driver test over Dragon Board"
	depends on TOUCHSCREEN_HIMAX_I2C
	help
	  This enables support for HIMAX driver test over Dragon Board.
```
